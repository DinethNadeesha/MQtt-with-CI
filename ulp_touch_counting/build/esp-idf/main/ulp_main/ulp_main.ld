
/* ULP variable definitions for the linker.
 * This file is generated automatically by esp32ulp_mapgen.py utility.
 */
PROVIDE ( ulp_entry = 0x50000000 );
PROVIDE ( ulp_ulp_high_thr = 0x50000084 );
PROVIDE ( ulp_ulp_last_result = 0x5000008c );
PROVIDE ( ulp_ulp_low_thr = 0x50000080 );
PROVIDE ( ulp_ulp_sample_counter = 0x50000088 );
PROVIDE ( ulp_ulp_touch_counter = 0x50000090 );
PROVIDE ( ulp_wake_up_and_count = 0x50000058 );
